## conf/layer.conf
```bitbake
# We have a conf and classes directory, add to BBPATH
BBPATH .= ":${LAYERDIR}"

# We have recipes-* directories, add to BBFILES
BBFILES +=  "${LAYERDIR}/recipes-*/*/*.bb"
BBFILES +=  " ${LAYERDIR}/recipes-*/*/*.bbappend "

BBFILE_COLLECTIONS += "swupdate"
BBFILE_PATTERN_swupdate = "^${LAYERDIR}/"
BBFILE_PRIORITY_swupdate = "6"

# This should only be incremented on significant changes that will
# cause compatibility issues with other layers
LAYERVERSION_swupdate = "1"

LAYERDIR_swupdate = "${LAYERDIR}"
```
